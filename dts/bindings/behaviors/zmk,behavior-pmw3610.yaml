## dts/bindings/behaviors/zmk,behavior-pmw3610.yaml
```yaml
# Copyright (c) 2026 The ZMK Contributors
# SPDX-License-Identifier: MIT

description: PMW3610 runtime pointer control behavior

compatible: "zmk,behavior-pmw3610"

include: one_param.yaml
```

## dts/bindings/pixart,pmw3610.yml
```yaml
description: |
  Sensor driver for the pixart PMW3610 mouse sensor 

compatible: "pixart,pmw3610"

include: spi-device.yaml

properties:
  irq-gpios:
    type: phandle-array
    required: true
  scroll-layers:
    type: array
    default: []
  snipe-layers:
    type: array
    default: []
  automouse-layer:
    type: int
    default: -1
  runtime-default-cpi:
    type: int
    default: 400
    description: Initial normal CPI used by runtime pointer controls
  runtime-default-snipe-cpi:
    type: int
    default: 400
    description: Initial sniping CPI used by runtime pointer controls
```
